#define L00  0  // left-first row
#define L01  1
#define L02  2
#define L03  3
#define L04  4
#define L05  5
#define L06  6

#define R00  7  // right-first row
#define R01  8
#define R02  9
#define R03 10
#define R04 11
#define R05 12
#define R06 13

#define L10 14  // left-second row
#define L11 15
#define L12 16
#define L13 17
#define L14 18
#define L15 19
#define L16 20

#define R10 21  // right-second row
#define R11 22
#define R12 23
#define R13 24
#define R14 25
#define R15 26
#define R16 27

#define L20 28  // left-third row
#define L21 29
#define L22 30
#define L23 31
#define L24 32
#define L25 33
#define L26 34

#define R20 39  // right-third row
#define R21 40
#define R22 41
#define R23 42
#define R24 43
#define R25 44
#define R26 45

#define L30 46  // left-fourth row
#define L31 47
#define L32 48
#define L33 49
#define L34 50
#define L35 51

#define R30 54  // right-fourth row
#define R31 55
#define R32 56
#define R33 57
#define R34 58
#define R35 59

#define L40 60  // left-fifth row
#define L41 61
#define L42 62
#define L43 63
#define L44 64

#define R40 71  // right-fifth row
#define R41 72
#define R42 73
#define R43 74
#define R44 75

#define LT00 35  // left thumb keys
#define LT01 36
#define LT10 52
#define LT20 65
#define LT21 66
#define LT22 67


#define RT00 37  // right thumb keys
#define RT01 38
#define RT10 53
#define RT20 68
#define RT21 69
#define RT22 70

#define KEYS_L  L00  L01  L02  L03  L04  L05  L06 \
                L10  L11  L12  L13  L14  L15  L16 \
                L20  L21  L22  L23  L24  L25  L26 \
                L30  L31  L32  L33  L34  L35      \
                L40  L41  L42  L43  L44

#define THUMBS_LEFT      LT00 LT01 \
                              LT10 \
                    LT20 LT21 LT22 \

#define KEYS_R  R00  R01  R02  R03  R04  R05  R06 \
                R10  R11  R12  R13  R14  R15  R16 \
                R20  R21  R22  R23  R24  R25  R26 \
                R30  R31  R32  R33  R34  R35      \
                R40  R41  R42  R43  R44

#define THUMBS_RIGHT     RT00 RT01 \
                              RT10 \
                    RT20 RT21 RT22 \

#define THUMBS THUMBS_LEFT THUMBS_RIGHT

#define QUICK_TAP_MS 175

#define TAB_RT RC(TAB)
#define TAB_LT LC(LS(TAB))

&sk {
  release-after-ms = <900>;
  quick-release;
};

&sl { // Allow sticky mods to chord across sticky layers.
  ignore-modifiers;
};

&lt {
  flavor = "balanced";
  tapping-term-ms = <200>;
  quick-tap-ms = <QUICK_TAP_MS>;
};

//tap-dance for home/end
ZMK_TAP_DANCE(td0,
    tapping-term-ms = <400>;
    bindings = <&kp HOME>, <&kp END>;)

#define SMART_NUM &smart_num NUM 0
ZMK_HOLD_TAP(smart_num, bindings = <&mo>, <&num_dance>; flavor = "balanced";
             tapping-term-ms = <200>; quick-tap-ms = <QUICK_TAP_MS>;)
ZMK_TAP_DANCE(num_dance, bindings = <&num_word NUM>, <&sl NUM>;
              tapping-term-ms = <200>;)

#define CANCEL    &kp K_CANCEL            // Cancel caps-word & auto-layers.


/* Homerow mods */

#define MAKE_HRM(NAME, HOLD, TAP, TRIGGER_POS)                                 \
  ZMK_HOLD_TAP(NAME, bindings = <HOLD>, <TAP>; flavor = "balanced";            \
               tapping-term-ms = <280>; quick-tap-ms = <QUICK_TAP_MS>;         \
               require-prior-idle-ms = <150>; hold-trigger-on-release;         \
               hold-trigger-key-positions = <TRIGGER_POS>;)

MAKE_HRM(hml, &kp, &kp, KEYS_R THUMBS) // Left-hand HRMs.
MAKE_HRM(hmr, &kp, &kp, KEYS_L THUMBS) // Right-hand HRMs.

// Hack: Make HRM combos tap-only (cf, ZMK issue #544).
//#define ZMK_COMBO_8(NAME, TAP, POS, LAYERS, COMBO_MS, IDLE_MS, HOLD, SIDE)     \
//  MAKE_HRM(hm_combo_##NAME, &kp, TAP, SIDE THUMBS)                             \
//  ZMK_COMBO_6(NAME, &hm_combo_##NAME HOLD 0, POS, LAYERS, COMBO_MS, IDLE_MS)

// Smart-mouse, requires tri-state module.
ZMK_TRI_STATE(smart_mouse, bindings = <&tog MOUSE>, <&none>, <&tog MOUSE>;
    ignored-key-positions = <L21 L31 R22 R23 R24 R25 LT00 LT01 LT20 LT21 RT01 RT21 RT22>;
    ignored-layers = <MOUSE SYM FN>;)


/********** THE FOLLOWING SECTION IS NOT CURRENTLY BEING USED **********/
/* Nav cluster */
/*
// Trigger tap-action on all interrupts.
#define MT_CORE                                                                \
  flavor = "tap-preferred";                                                    \
  tapping-term-ms = <220>;                                                     \
  quick-tap-ms = <220>;                                                        \
  hold-trigger-key-positions = <0>;

&mt { MT_CORE };

ZMK_HOLD_TAP(mt_home, bindings = <&masked_home>, <&kp>; MT_CORE)
ZMK_HOLD_TAP(mt_end, bindings = <&masked_end>, <&kp>; MT_CORE)

#define NAV_LEFT  &mt_home 0   LEFT  // Tap: left  | Long-tap: start of line.
#define NAV_RIGHT &mt_end 0    RIGHT // Tap: right | Long-tap: end   of line.
#define NAV_UP    &mt LC(HOME) UP    // Tap: up    | Long-tap: start of doc.
#define NAV_DOWN  &mt LC(END)  DOWN  // Tap: down  | Long-tap: end   of doc.
#define NAV_BSPC  &mt LG(BSPC) BSPC  // Tap: bspc  | Long-tap: delete word bwd.
#define NAV_DEL   &mt LG(DEL)  DEL   // Tap: del   | Long-tap: delete word fwd.

ZMK_HOLD_TAP(up_ralt, bindings = <&kp>, <&kp>; MT_CORE)
// Mask CTRL on left/right hold to avoid accidental jumps to start/end of doc.
#define MASK_MODS(NAME, MODS, BINDING)                                         \
  ZMK_MOD_MORPH(NAME, bindings = <BINDING>, <BINDING>; mods = <MODS>;)

MASK_MODS(masked_home, (MOD_LCTL), &kp HOME)
MASK_MODS(masked_end,  (MOD_LCTL), &kp END)*/

/* Caps-word & auto-layers */

/* MAGIC SHIFT - Repeat/Sticky-shift/Capsword/Shift
/* #define MAGIC_SHIFT &magic_shift LSHFT 0 */
/* ZMK_HOLD_TAP(magic_shift, bindings = <&kp>, <&magic_shift_tap>; */
/*              flavor = "hold-preferred"; tapping-term-ms = <200>; */
/*              quick-tap-ms = <QUICK_TAP_MS>;) */
/* ZMK_MOD_MORPH(magic_shift_tap, bindings = <&kp ENTER>, <&caps_word>; */
/*               mods = <(MOD_LSFT)>;) */

/* // Tap: enter | Shift + tap/ double-tap: caps-word | Hold: shift. */
/* ZMK_MOD_MORPH(smart_shft, */
/*   bindings = <&kp ENTER>, <&caps_word>; */
/*   mods = <(MOD_LSFT)>; */
/* ) */

/* &caps_word { // Mods deactivate caps-word, requires PR #1451. [TODO: rebase] */
/*   /delete-property/ ignore-modifiers; */
/* }; */

// Tap: Enter | hold: shift
//ZMK_HOLD_TAP(shft_enter, bindings = <&kp>, <&kp>; flavor = "hold-preferred"; 
//              tapping-term-ms = <200>; quick-tap-ms = <QUICK_TAP_MS>;)

/* Custom behaviors */

// Alt+Tab swapper, requires tri-state module.
//ZMK_TRI_STATE(swapper, bindings = <&kt LALT>, <&kp TAB>, <&kt LALT>;
//              ignored-key-positions = <L44>;)

// Define mod-morph with a *single* mod trigger for less repetition.
//#define SIMPLE_MORPH(NAME, MOD, BINDING1, BINDING2)                            \
//  ZMK_MOD_MORPH(NAME, mods = <(MOD_L##MOD | MOD_R##MOD)>;                      \
//                bindings = <BINDING1>, <BINDING2>;)

// Tap: space | Shift + tap: dot -> space -> sticky shift | Hold: nav layer.
/* ZMK_HOLD_TAP(lt_spc, bindings = <&mo>, <&spc_morph>; flavor = "balanced"; */
/*              tapping-term-ms = <200>; quick-tap-ms = <QUICK_TAP_MS>;) */
/* SIMPLE_MORPH(spc_morph, SFT, &kp SPACE, &dot_spc) */
/* ZMK_MACRO(dot_spc, bindings = <&kp DOT &kp SPACE &sk LSHFT>; wait-ms = <0>; */
/*           tap-ms = <5>;) */

// Tap: space | Hold: nav layer
//ZMK_HOLD_TAP(lt_spc, bindings = <&mo>, <&kp>; flavor = "balanced"; 
//              tapping-term-ms = <200>; quick-tap-ms = <QUICK_TAP_MS>;)

// Tap: backspace | Lshft + tap: delete | Rshft + tap: shift-delete.
// ZMK_MOD_MORPH(bs_del, bindings = <&kp BSPC>, <&kp DEL>;
              // mods = <(MOD_LSFT|MOD_RSFT)>; keep-mods = <MOD_RSFT>;)

// Tap: copy | double-tap: cut.
// ZMK_TAP_DANCE(copy_cut, bindings = <&kp LC(INS)>, <&kp LC(X)>;
              // tapping-term-ms = <200>;)
